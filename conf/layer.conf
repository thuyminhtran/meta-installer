## conf/layer.conf
```bitbake
# We have a conf and classes directory, add to BBPATH
BBPATH =. "${LAYERDIR}:"

# We have a packages directory, add to BBFILES
BBFILES += "${LAYERDIR}/recipes-*/*/*.bb \
            ${LAYERDIR}/recipes-*/*/*.bbappend"

BBFILE_COLLECTIONS += "meta-installer"
BBFILE_PATTERN_meta-installer = "^${LAYERDIR}/"
BBFILE_PRIORITY_meta-installer = "10"

LAYERVERSION_meta-installer = "2"

LAYERDEPENDS_meta-installer = " \
    core \
    openembedded-layer \
    filesystems-layer \
    gnome-layer \
    meta-python \
    networking-layer \
    meta-initramfs \
"

LICENSE_PATH += "${LAYERDIR}/licenses"
SRC_DISTRIBUTE_LICENSES += "X11"
SRC_DISTRIBUTE_LICENSES += "FLTK"

LAYER_PATH_meta-installer = "${LAYERDIR}"

KERNEL_CLASSES_append = "${@bb.utils.contains('DISTRO_FEATURES', 'installer-support', ' installer_support_kernel', '', d)}"
IMAGE_CLASSES_append = " ${@bb.utils.contains('DISTRO_FEATURES', 'installer-support', ' installer_support_image', '', d)}"
```
